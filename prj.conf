## CMakeLists.txt
```
cmake_minimum_required(VERSION 3.20.0)

find_package(Zephyr REQUIRED HINTS $ENV{ZEPHYR_BASE})
project(sensor_hub)

target_include_directories(app PRIVATE inc)
target_sources(app PRIVATE src/main.c src/wenet_service.c src/notify.c)
```

## west.yml
```
manifest:
  version: "0.13"
  
  self:
    path: sensor_hub
  
  remotes:
    - name: ncs
      url-base: https://github.com/nrfconnect
  
  projects:
    - name: nrf
      remote: ncs
      repo-path: sdk-nrf
      revision: v3.0.0
      import: true
```

## prj.conf
```kconfig
CONFIG_CONSOLE=y
CONFIG_UART_INTERRUPT_DRIVEN=y

CONFIG_USB_DEVICE_STACK=y
CONFIG_USB_DEVICE_PRODUCT="Wenet Sensor Hub"
CONFIG_USB_DEVICE_PID=0x0001


# BLE configuration
CONFIG_BT=y
CONFIG_BT_PERIPHERAL=y
CONFIG_BT_DEVICE_NAME="Wenet"

# UF2 for building for adafruit feather nrf52840
CONFIG_BUILD_OUTPUT_UF2=y
CONFIG_ROM_START_OFFSET=0x1000
```

## src/main.c
```c
#include <zephyr/kernel.h>
#include "wenet_service.h"
#include "notify.h"

#define WENET_NOTIFY_STACK_SIZE 1024

extern void wenet_notify_thread(void *p1, void *p2, void *p3);
K_THREAD_STACK_DEFINE(wenet_notify_stack, WENET_NOTIFY_STACK_SIZE);
struct k_thread wenet_notify;

int main(void)
{
    wenet_service_init();
    // Wenet Nofication Thread
    k_thread_create(&wenet_notify, wenet_notify_stack, WENET_NOTIFY_STACK_SIZE,
                    wenet_notify_thread, NULL, NULL, NULL,
                    7, 0, K_NO_WAIT);
    int i = 0;
    while(1)
    {
        // Main loop
        k_sleep(K_MSEC(100));
        struct wenet_packet packet = {
            .packet_id = 0x01,
            .sequence_number = i,
            .payload_size = 4,
            .payload = {0xDE, 0xAD, 0xBE, 0xEF}
        };
        wenet_send_notify(&packet);
        i++;
    }
}
```

## inc/notify.h
```c
#include <stdint.h>

#define WENET_PACKET_HEADER_SIZE 3
// Maximum payload size in bytes
#define WENET_MAX_PAYLOAD_SIZE 16
// Number of entries in thread message queue
#define NOTIFY_MESGQ_ENTRIES 32
// Maximum number of outbound notifications
#define NOTIFY_MAX_QUEUED 32

struct wenet_packet {
    uint8_t packet_id;
    uint16_t sequence_number;
    uint8_t payload_size;
    uint8_t payload[WENET_MAX_PAYLOAD_SIZE];
};

void wenet_send_notify(struct wenet_packet *packet);
```

## inc/param_stack.h
```c
#include <zephyr/bluetooth/gatt.h>
int param_stack_get_notify(struct bt_gatt_notify_params **data);
int param_stack_free_notify(struct bt_gatt_notify_params *data);
```

## inc/wenet_service.h
```c
#ifndef WENET_SERVICE_H
#define WENET_SERVICE_H

#include <zephyr/bluetooth/gatt.h>

#define WENET_SERVICE_ENCODE BT_UUID_128_ENCODE(0xFB63FEB8, 0x31AD, 0x451D, 0xA587, 0x9FC20F9C8ADD)
#define WENET_SERVICE_UUID BT_UUID_DECLARE_128(WENET_SERVICE_ENCODE)

#define WENET_SENSOR_CHAR_UUID BT_UUID_DECLARE_128( \
    BT_UUID_128_ENCODE(0x3D235F0E, 0x61F8, 0x4455, 0x89C6, 0x2F7D73C33178))

#define WENET_SENSOR_UART_UUID BT_UUID_DECLARE_128( \
    BT_UUID_128_ENCODE(0x64A96749, 0xAB48, 0x434D, 0x8D31, 0x77C07E6E352F))

void wenet_service_init(void);

#endif // WENET_SERVICE_H
```

## src/notify.c
```c
#include <zephyr/kernel.h>
#include <zephyr/bluetooth/gatt.h>
#include "notify.h"

extern const struct bt_gatt_service_static wenet_service;

// Message queue for Wenet notification packets
char msgq_buffer[NOTIFY_MESGQ_ENTRIES * sizeof(struct wenet_packet)];
struct k_msgq notify_mesgq;

void wenet_send_notify(struct wenet_packet *packet)
{
    // Send the packet to the message queue
    k_msgq_put(&notify_mesgq, packet, K_NO_WAIT);
}

// Thread loop for Wenet notification packets
void wenet_notify_thread(void *p1, void *p2, void *p3)
{
    k_msgq_init(&notify_mesgq, msgq_buffer, sizeof(struct wenet_packet), NOTIFY_MESGQ_ENTRIES);
    while (1) {
        struct wenet_packet packet;
        k_msgq_get(&notify_mesgq, &packet, K_FOREVER);

        // Build packet
        int ble_packet_size = WENET_PACKET_HEADER_SIZE + packet.payload_size;
        uint8_t ble_packet[WENET_PACKET_HEADER_SIZE + WENET_MAX_PAYLOAD_SIZE];
        ble_packet[0] = packet.packet_id;
        memcpy(&ble_packet[1], &packet.sequence_number, sizeof(packet.sequence_number));
        memcpy(&ble_packet[3], packet.payload, packet.payload_size);
        bt_gatt_notify(NULL, &wenet_service.attrs[1], &ble_packet, ble_packet_size);
    }
}
```

## src/param_stack.c
```c
#include <zephyr/kernel.h>
#include <zephyr/init.h>
#include <zephyr/bluetooth/gatt.h>
#include "param_stack.h"

#define MAX_ITEMS 50

static struct bt_gatt_notify_params notify_params[MAX_ITEMS];

K_STACK_DEFINE(notify_stack, MAX_ITEMS);

static int param_stack_init(void)
{
    // Push to stack
    int i;
    for(i = 0; i < MAX_ITEMS; i++){
        k_stack_push(&notify_stack, (stack_data_t)&notify_params[i]);
    }
    return 0;
}

int param_stack_get_notify(struct bt_gatt_notify_params **data)
{
    return k_stack_pop(&notify_stack, (stack_data_t*)data, K_NO_WAIT);
}

int param_stack_free_notify(struct bt_gatt_notify_params *data)
{
    return k_stack_push(&notify_stack, (stack_data_t)data);
}

SYS_INIT(param_stack_init, APPLICATION, CONFIG_KERNEL_INIT_PRIORITY_DEFAULT);
```

## src/wenet_service.c
```c
#include "wenet_service.h"

BT_GATT_SERVICE_DEFINE(wenet_service,
    BT_GATT_PRIMARY_SERVICE(WENET_SERVICE_UUID),
    BT_GATT_CHARACTERISTIC(WENET_SENSOR_CHAR_UUID,
        BT_GATT_CHRC_READ | BT_GATT_CHRC_NOTIFY, BT_GATT_PERM_READ, NULL, NULL, NULL),
    BT_GATT_CUD("Wenet Packet Interface", BT_GATT_PERM_READ),
    BT_GATT_CCC(NULL, BT_GATT_PERM_READ | BT_GATT_PERM_WRITE)
);

// Define the advertising data
static const struct bt_data ad[] = {
	BT_DATA_BYTES(BT_DATA_FLAGS, (BT_LE_AD_GENERAL | BT_LE_AD_NO_BREDR)),
	BT_DATA(BT_DATA_NAME_COMPLETE, CONFIG_BT_DEVICE_NAME, sizeof(CONFIG_BT_DEVICE_NAME) - 1),
    BT_DATA_BYTES(BT_DATA_UUID128_SOME, WENET_SERVICE_ENCODE)
};

// Implement the advertising start function as a workqueue
// This is to prevent an error since an exsiting connect is not fully 
// closed until the disconnect callback is finished
static void adv_start_work(struct k_work *work)
{
    int err;
    err = bt_le_adv_start(BT_LE_ADV_CONN_FAST_1, ad, ARRAY_SIZE(ad), NULL, 0);
    if (err) {
        printk("Advertising failed to start (err %d)\n", err);
        // Retry after a delay
        k_work_schedule(k_work_delayable_from_work(work), K_SECONDS(5));
        return;
    }
    printk("Advertising started\n");
}
K_WORK_DELAYABLE_DEFINE(adv_start, adv_start_work);

// Connection callbacks
static void connected(struct bt_conn *conn, uint8_t err)
{
    char addr[BT_ADDR_LE_STR_LEN];
	bt_addr_le_to_str(bt_conn_get_dst(conn), addr, sizeof(addr));

    if (err) {
        printk("Connection failed (err %d)\n", err);
        return;
    }

    printk("Connected: %s\n", addr);
}

static void disconnected(struct bt_conn *conn, uint8_t reason)
{
    printk("Disconnected (reason %u)\n", reason);
    k_work_schedule(&adv_start, K_MSEC(500));
}

static struct bt_conn_cb conn_callbacks = {
    .connected = connected,
    .disconnected = disconnected,
};

void wenet_uart_init(void)
{
    // Initialize UART here if needed
    // This is a placeholder for UART initialization

}

void wenet_service_init(void)
{
    int err = bt_enable(NULL);
    if (err) {
        printk("Bluetooth init failed (err %d)\n", err);
        return;
    }
    // Register the connection callbacks
    bt_conn_cb_register(&conn_callbacks);
    
    // Start advertising
    k_work_schedule(&adv_start, K_NO_WAIT);
}
```
